## fw/boards/arm/usb_led_matrix/Kconfig.board
```kconfig
# STM32G474RE Nucleo board configuration

# Copyright (c) 2019 STMicroelectronics.
# SPDX-License-Identifier: Apache-2.0

config BOARD_USB_LED_MATRIX
	bool "USB LED matrix board"
	depends on SOC_STM32G474XX

select USE_STM32_HAL_FLASH
select USE_STM32_HAL_FLASH_EX
```

## fw/boards/arm/usb_led_matrix/Kconfig.defconfig
```kconfig
# STM32G474RE Nucleo board configuration

# Copyright (c) 2019 STMicroelectronics.
# SPDX-License-Identifier: Apache-2.0

if BOARD_USB_LED_MATRIX

config BOARD
	default "usb_led_matrix"

config USE_STM32_LL_CRS
	default y


endif # BOARD_USB_LED_MATRIX
```
